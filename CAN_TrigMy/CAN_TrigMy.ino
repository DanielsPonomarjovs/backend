/// CAN Receive Example
//

#include <mcp_can.h>
#include <SPI.h>

long unsigned int rxId;
unsigned char len = 0;
unsigned char rxBuf[8];
char msgString[128];                        // Array to store serial string

#define CAN0_INT 2                              // Set INT to pin 2
MCP_CAN CAN0(10);                               // Set CS to pin 10


byte txBuf0[] = {0x10,0x5A,0x00,0x58,0xAA,0x01,0x55,0x0A};
byte txBuf1[] = {0x21,0x53,0x0A,0x06,0x0A,0x04,0xAF,0xD2};
byte txBuf2[] = {0x22,0xB4,0xDD,0x10,0x01,0x22,0x43,0x0A};
byte txBuf3[] = {0x23,0x41,0x04,0x3E,0x11,0xFC,0xB8,0x0C}; 
byte txBuf4[] = {0x24,0xC1,0x63,0x9B,0x1D,0x86,0x2C,0x8A}; 
byte txBuf5[] = {0x25,0xCD,0x7C,0x8C,0x18,0x55,0xCF,0xD1}; 
byte txBuf6[] = {0x26,0x79,0x98,0xEE,0xD3,0x7C,0x32,0x23}; 
byte txBuf7[] = {0x27,0xB1,0x0C,0x16,0x74,0x66,0x4A,0xE1}; 
byte txBuf8[] = {0x28,0xBB,0xFA,0xBA,0xC7,0x8D,0x4D,0xE7}; 
byte txBuf9[] = {0x29,0x9A,0xEB,0x4E,0x93,0x75,0xAC,0x6A}; 
byte txBuf10[] = {0x2A,0xFF,0x92,0x31,0xDD,0x6A,0x4F,0x16}; 
byte txBuf11[] = {0x2B,0x4D,0x2D,0x35,0xB8,0x77,0x1F,0x81}; 
byte txBuf12[] = {0x2C,0x95,0x41,0x9F,0x28,0x01,0x30,0x01}; 
byte txBuf13[] = {0x10,0x58,0x00,0x56,0xAA,0x01,0x53,0x0A}; 
byte txBuf14[] = {0x21,0x51,0x0A,0x06,0x0A,0x04,0xAF,0xD2}; 
byte txBuf15[] = {0x22,0xB4,0xDD,0x22,0x43,0x0A,0x41,0x04};
byte txBuf16[] = {0x23,0x3E,0x11,0xFC,0xB8,0x0C,0xC1,0x63};
byte txBuf17[] = {0x24,0x9B,0x1D,0x86,0x2C,0x8A,0xCD,0x7C}; 
byte txBuf18[] = {0x25,0x8C,0x18,0x55,0xCF,0xD1,0x79,0x98}; 
byte txBuf19[] = {0x26,0xEE,0xD3,0x7C,0x32,0x23,0xB1,0x0C}; 
byte txBuf20[] = {0x27,0x16,0x74,0x66,0x4A,0xE1,0xBB,0xFA}; 
byte txBuf21[] = {0x28,0xBA,0xC7,0x8D,0x4D,0xE7,0x9A,0xEB}; 
byte txBuf22[] = {0x29,0x4E,0x93,0x75,0xAC,0x6A,0xFF,0x92}; 
byte txBuf23[] = {0x2A,0x31,0xDD,0x6A,0x4F,0x16,0x4D,0x2D}; 
byte txBuf24[] = {0x2B,0x35,0xB8,0x77,0x1F,0x81,0x95,0x41}; 
byte txBuf25[] = {0x2C,0x9F,0x28,0x01,0x30,0x01};        

void setup()
{
  Serial.begin(115200);
  
  // Initialize MCP2515 running at 16MHz with a baudrate of 500kb/s and the masks and filters disabled.
  if(CAN0.begin(MCP_ANY, CAN_500KBPS, MCP_8MHZ) == CAN_OK)
    Serial.println("MCP2515 Initialized Successfully!");
  else
    Serial.println("Error Initializing MCP2515...");
  
  CAN0.setMode(MCP_NORMAL);                     // Set operation mode to normal so the MCP2515 sends acks to received data.

  pinMode(CAN0_INT, INPUT);                            // Configuring pin for /INT input
  
  Serial.println("MCP2515 Library Receive Example...");
  CAN0.sendMsgBuf(0x1D9, 0, 8, txBuf0);
  
}

void loop()
{
  if(!digitalRead(CAN0_INT))                         // If CAN0_INT pin is low, read receive buffer
  {
    CAN0.readMsgBuf(&rxId, &len, rxBuf);      // Read data: len = data length, buf = data byte(s)
    
    // if((rxId & 0x80000000) == 0x80000000)     // Determine if ID is standard (11 bits) or extended (29 bits)
     //  sprintf(msgString, "Extended ID: 0x%.8lX  DLC: %1d  Data:", (rxId & 0x1FFFFFFF), len);
     //else
      // sprintf(msgString, "Standard ID: 0x%.3lX       DLC: %1d  Data:", rxId, len);
  
    // Serial.print(msgString);
  
    if((rxId & 0x481) == 0x481){    // Determine if message is a remote request frame.
   // byte sndStat = CAN0.sendMsgBuf(0x1D9, 0, 8, data);
   CAN0.sendMsgBuf(0x1D9, 0, 8, txBuf1);

      // sprintf(msgString, " REMOTE REQUEST FRAME");
      
    //   Serial.print(msgString);
    // } else {
     //  for(byte i = 0; i<len; i++){
        // sprintf(msgString, " 0x%.2X", rxBuf[i]);
       //  Serial.print(msgString);
      // }
    }
        
    // Serial.println();
  }
}

/*********************************************************************************************************
  END FILE
*********************************************************************************************************/
